/*A2L file generated by TOSUN A2LEditor alpha version.*/ ASAP2_VERSION 1 71
/begin PROJECT ELC_A2L ""
/begin MODULE ELC_A2L ""
/begin MOD_COMMON "" ALIGNMENT_BYTE 1 ALIGNMENT_WORD 2 ALIGNMENT_LONG 4 ALIGNMENT_INT64 8 ALIGNMENT_FLOAT16_IEEE 2 ALIGNMENT_FLOAT32_IEEE 4 ALIGNMENT_FLOAT64_IEEE 8 BYTE_ORDER MSB_LAST /end MOD_COMMON
/begin MOD_PAR "" /end MOD_PAR
/begin CHARACTERISTIC OS_XCP_U8_CPU_Load "" VALUE 0x20003CDC __u8 0 NO_COMPU_METHOD 0 0 ENCODING UTF8 NUMBER 0 /end CHARACTERISTIC
/begin RECORD_LAYOUT __u8 FNC_VALUES 1 UBYTE COLUMN_DIR DIRECT /end RECORD_LAYOUT
/begin CHARACTERISTIC SMon_ISenseL1_ExtChISense "" VALUE 0x200004EC float 0 NO_COMPU_METHOD 0 0 CALIBRATION_ACCESS CALIBRATION ENCODING UTF32 NUMBER 0 /end CHARACTERISTIC
/begin CHARACTERISTIC EcuM_WUPLine "" VALUE 0x2000031C __u8 0 NO_COMPU_METHOD 0 0 ENCODING UTF8 NUMBER 0 /end CHARACTERISTIC
/begin RECORD_LAYOUT float ALIGNMENT_FLOAT32_IEEE 4 FNC_VALUES 1 FLOAT32_IEEE ROW_DIR PBYTE /end RECORD_LAYOUT
/begin RECORD_LAYOUT uint32 ALIGNMENT_LONG 4 FNC_VALUES 1 ULONG ROW_DIR PBYTE /end RECORD_LAYOUT
/begin CHARACTERISTIC Nvm_CurrentAddress "" VALUE 0x20000A14 uint32 0 NO_COMPU_METHOD 0 0 ENCODING UTF32 NUMBER 0 /end CHARACTERISTIC
/begin CHARACTERISTIC Nvm_SectorSwitchActivated "" VALUE 0x20000A10 uint32 0 NO_COMPU_METHOD 0 0 ENCODING UTF32 NUMBER 0 /end CHARACTERISTIC
/begin CHARACTERISTIC Nvm_CurrentSector "" VALUE 0x20000A0C uint32 0 NO_COMPU_METHOD 0 0 ENCODING UTF32 NUMBER 0 /end CHARACTERISTIC
/begin CHARACTERISTIC oscnt "" VALUE 0x20003CD8 uint32 0 NO_COMPU_METHOD 0 0 ENCODING UTF32 NUMBER 0 /end CHARACTERISTIC
/begin CHARACTERISTIC Ain_DmaBuffer[0] "" VALUE 0x20003DE4 uint16 0 NO_COMPU_METHOD 0 0 ENCODING UTF8 NUMBER 0 /end CHARACTERISTIC
/begin CHARACTERISTIC Ain_DmaBuffer[1] "" VALUE 0x20003DE6 uint16 0 NO_COMPU_METHOD 0 0 ENCODING UTF8 NUMBER 0 /end CHARACTERISTIC
/begin CHARACTERISTIC Ain_DmaBuffer[2] "" VALUE 0x20003DE8 uint16 0 NO_COMPU_METHOD 0 0 ENCODING UTF8 NUMBER 0 /end CHARACTERISTIC
/begin CHARACTERISTIC Ain_DmaBuffer[3] "" VALUE 0x20003DEA uint16 0 NO_COMPU_METHOD 0 0 ENCODING UTF8 NUMBER 0 /end CHARACTERISTIC
/begin RECORD_LAYOUT uint16 ALIGNMENT_WORD 2 FNC_VALUES 1 UWORD ROW_DIR PBYTE /end RECORD_LAYOUT
/begin CHARACTERISTIC Ain_DmaBuffer[4] "" VALUE 0x20003DEC uint16 0 NO_COMPU_METHOD 0 0 ENCODING UTF8 NUMBER 0 /end CHARACTERISTIC
/begin CHARACTERISTIC SMon_PeakCurrent "" VALUE 0x200004F0 float 0 NO_COMPU_METHOD 0 0 ENCODING UTF32 NUMBER 0 /end CHARACTERISTIC
/end MODULE
/end PROJECT
