/*A2L file generated by TOSUN A2LEditor alpha version.*/ ASAP2_VERSION 1 71
/begin PROJECT ELC_A2L ""
/begin MODULE tosun_a2l_module_name ""
/end MODULE
/end PROJECT
