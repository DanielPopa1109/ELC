/*A2L file generated by TOSUN A2LEditor alpha version.*/ ASAP2_VERSION 1 71
/begin PROJECT ELC ""
/begin MODULE ELC ""
/begin MOD_COMMON "" ALIGNMENT_BYTE 1 ALIGNMENT_WORD 2 ALIGNMENT_LONG 4 ALIGNMENT_INT64 8 ALIGNMENT_FLOAT16_IEEE 2 ALIGNMENT_FLOAT32_IEEE 4 ALIGNMENT_FLOAT64_IEEE 8 BYTE_ORDER MSB_LAST /end MOD_COMMON
/begin MOD_PAR "" /end MOD_PAR
/begin CHARACTERISTIC SMon_P_NTCTemperatureMax "" VALUE 0x20000070 __u32 0 NO_COMPU_METHOD 0 4294967295 ENCODING UTF8 NUMBER 0 /end CHARACTERISTIC
/begin RECORD_LAYOUT __u32 FNC_VALUES 1 ULONG COLUMN_DIR DIRECT /end RECORD_LAYOUT
/begin CHARACTERISTIC SMon_P_Rtcntmax "" VALUE 0x20000100 __u32 0 NO_COMPU_METHOD 0 4294967295 /end CHARACTERISTIC
/begin CHARACTERISTIC SMon_P_VFB_T30_TwoPointCalibration_ParamB "" VALUE 0x200000B8 __u32 0 NO_COMPU_METHOD 0 4294967295 /end CHARACTERISTIC
/begin CHARACTERISTIC SMon_P_ExternalChargerThreshold "" VALUE 0x20000074 __u32 0 NO_COMPU_METHOD 0 4294967295 /end CHARACTERISTIC
/begin CHARACTERISTIC SMon_P_BattSoHMax_pct "" VALUE 0x2000002C __u32 0 NO_COMPU_METHOD 0 4294967295 /end CHARACTERISTIC
/begin CHARACTERISTIC SMon_P_VFB_L1_TwoPointCalibration_ParamA "" VALUE 0x200000B4 __u32 0 NO_COMPU_METHOD 0 4294967295 /end CHARACTERISTIC
/begin CHARACTERISTIC SMon_P_BattAlphaRint "" VALUE 0x2000003C __u32 0 NO_COMPU_METHOD 0 4294967295 /end CHARACTERISTIC
/begin CHARACTERISTIC SMon_P_StatusVoltageL1Filter "" VALUE 0x20000108 __u32 0 NO_COMPU_METHOD 0 4294967295 /end CHARACTERISTIC
/begin CHARACTERISTIC SMon_P_BattBadRint_Ohm "" VALUE 0x20000024 __u32 0 NO_COMPU_METHOD 0 4294967295 /end CHARACTERISTIC
/begin CHARACTERISTIC SMon_P_BattWeakVolt_V "" VALUE 0x20000050 __u32 0 NO_COMPU_METHOD 0 4294967295 /end CHARACTERISTIC
/begin CHARACTERISTIC SMon_P_BattAlphaCurr "" VALUE 0x20000040 __u32 0 NO_COMPU_METHOD 0 4294967295 /end CHARACTERISTIC
/begin CHARACTERISTIC SMon_P_WaitTimeOVUV "" VALUE 0x200000F8 __u32 0 NO_COMPU_METHOD 0 4294967295 /end CHARACTERISTIC
/begin CHARACTERISTIC SMon_P_ClsFailureWaitTime "" VALUE 0x200000EC __u32 0 NO_COMPU_METHOD 0 4294967295 /end CHARACTERISTIC
/begin CHARACTERISTIC SMon_P_AvgSlope "" VALUE 0x20000094 __u32 0 NO_COMPU_METHOD 0 4294967295 /end CHARACTERISTIC
/begin CHARACTERISTIC SMon_P_RoomTempKelvin "" VALUE 0x2000009C __u32 0 NO_COMPU_METHOD 0 4294967295 /end CHARACTERISTIC
/begin CHARACTERISTIC SMon_P_WaitTimeCPC "" VALUE 0x200000F4 __u32 0 NO_COMPU_METHOD 0 4294967295 /end CHARACTERISTIC
/begin CHARACTERISTIC SMon_P_BattChargePathDeltaOff_V "" VALUE 0x2000000C __u32 0 NO_COMPU_METHOD 0 4294967295 /end CHARACTERISTIC
/begin CHARACTERISTIC SMon_P_10sCycles "" VALUE 0x20000110 __u32 0 NO_COMPU_METHOD 0 4294967295 /end CHARACTERISTIC
/begin CHARACTERISTIC SMon_P_ISenseZeroOffset_A "" VALUE 0x20000018 __u32 0 NO_COMPU_METHOD 0 4294967295 /end CHARACTERISTIC
/begin CHARACTERISTIC SMon_P_ADC_MaxValue "" VALUE 0x200000D0 __u32 0 NO_COMPU_METHOD 0 4294967295 /end CHARACTERISTIC
/begin CHARACTERISTIC SMon_P_BattRestVoltDelta_V "" VALUE 0x20000058 __u32 0 NO_COMPU_METHOD 0 4294967295 /end CHARACTERISTIC
/begin CHARACTERISTIC SMon_P_CLSTime "" VALUE 0x200000FC __u32 0 NO_COMPU_METHOD 0 4294967295 /end CHARACTERISTIC
/begin CHARACTERISTIC SMon_P_BattMaxSoC_pct "" VALUE 0x20000060 __u32 0 NO_COMPU_METHOD 0 4294967295 /end CHARACTERISTIC
/begin CHARACTERISTIC SMon_P_DischargeTimeCycles "" VALUE 0x200000E8 __u32 0 NO_COMPU_METHOD 0 4294967295 /end CHARACTERISTIC
/begin CHARACTERISTIC SMon_P_I2TDebounceTime "" VALUE 0x20000104 __u32 0 NO_COMPU_METHOD 0 4294967295 /end CHARACTERISTIC
/begin CHARACTERISTIC SMon_P_TwoPointCalib_NoLoad_ISense "" VALUE 0x20000078 __u32 0 NO_COMPU_METHOD 0 4294967295 /end CHARACTERISTIC
/begin CHARACTERISTIC SMon_P_LowDisTimeCyc "" VALUE 0x200000C0 __u32 0 NO_COMPU_METHOD 0 4294967295 /end CHARACTERISTIC
/begin CHARACTERISTIC SMon_P_I2TRating "" VALUE 0x200000A0 __u32 0 NO_COMPU_METHOD 0 4294967295 /end CHARACTERISTIC
/begin CHARACTERISTIC SMon_P_BattAlphaVolt "" VALUE 0x20000044 __u32 0 NO_COMPU_METHOD 0 4294967295 /end CHARACTERISTIC
/begin CHARACTERISTIC SMon_P_VFB_T30_TwoPointCalibration_ParamA "" VALUE 0x200000BC __u32 0 NO_COMPU_METHOD 0 4294967295 /end CHARACTERISTIC
/begin CHARACTERISTIC SMon_P_BattRestTimeTicks "" VALUE 0x20000054 __u32 0 NO_COMPU_METHOD 0 4294967295 /end CHARACTERISTIC
/begin CHARACTERISTIC SMon_P_BattCurrentAlpha "" VALUE 0x20000020 __u32 0 NO_COMPU_METHOD 0 4294967295 /end CHARACTERISTIC
/begin CHARACTERISTIC SMon_P_I2TDecrementPercentFactor "" VALUE 0x200000F0 __u32 0 NO_COMPU_METHOD 0 4294967295 /end CHARACTERISTIC
/begin CHARACTERISTIC SMon_P_TwoPointCalib_ConvFacISense "" VALUE 0x2000007C __u32 0 NO_COMPU_METHOD 0 4294967295 /end CHARACTERISTIC
/begin CHARACTERISTIC SMon_P_ISenseNominal "" VALUE 0x200000A4 __u32 0 NO_COMPU_METHOD 0 4294967295 /end CHARACTERISTIC
/begin CHARACTERISTIC SMon_P_UV_CLS "" VALUE 0x200000D8 __u32 0 NO_COMPU_METHOD 0 4294967295 /end CHARACTERISTIC
/begin CHARACTERISTIC SMon_P_BattDeepDischargeVolt_V "" VALUE 0x2000004C __u32 0 NO_COMPU_METHOD 0 4294967295 /end CHARACTERISTIC
/begin CHARACTERISTIC SMon_P_LongDischargeTimeCycles "" VALUE 0x200000C4 __u32 0 NO_COMPU_METHOD 0 4294967295 /end CHARACTERISTIC
/begin CHARACTERISTIC SMon_P_NTCTemperatureRelease "" VALUE 0x2000006C __u32 0 NO_COMPU_METHOD 0 4294967295 /end CHARACTERISTIC
/begin CHARACTERISTIC SMon_P_Kelvin "" VALUE 0x2000008C __u32 0 NO_COMPU_METHOD 0 4294967295 /end CHARACTERISTIC
/begin CHARACTERISTIC SMon_P_NTC_L1_TwoPointCalibration_ParamA "" VALUE 0x200000AC __u32 0 NO_COMPU_METHOD 0 4294967295 /end CHARACTERISTIC
/begin CHARACTERISTIC SMon_P_Varef "" VALUE 0x200000D4 __u32 0 NO_COMPU_METHOD 0 4294967295 /end CHARACTERISTIC
/begin CHARACTERISTIC SMon_P_BetaConst "" VALUE 0x200000C8 __u32 0 NO_COMPU_METHOD 0 4294967295 /end CHARACTERISTIC
/begin CHARACTERISTIC SMon_P_BattCurrentDeadband_A "" VALUE 0x2000001C __u32 0 NO_COMPU_METHOD 0 4294967295 /end CHARACTERISTIC
/begin CHARACTERISTIC SMon_P_BattNominalCapacity_Ah "" VALUE 0x20000068 __u32 0 NO_COMPU_METHOD 0 4294967295 /end CHARACTERISTIC
/begin CHARACTERISTIC SMon_P_AlphaFilter "" VALUE 0x20000084 __u32 0 NO_COMPU_METHOD 0 4294967295 /end CHARACTERISTIC
/begin CHARACTERISTIC SMon_P_BattAvgCurrentAlpha "" VALUE 0x20000004 __u32 0 NO_COMPU_METHOD 0 4294967295 /end CHARACTERISTIC
/begin CHARACTERISTIC SMon_P_BattNominalRint_Ohm "" VALUE 0x20000028 __u32 0 NO_COMPU_METHOD 0 4294967295 ENCODING UTF8 NUMBER 0 /end CHARACTERISTIC
/begin CHARACTERISTIC SMon_P_OV_KL30 "" VALUE 0x200000DC __u32 0 NO_COMPU_METHOD 0 4294967295 /end CHARACTERISTIC
/begin CHARACTERISTIC SMon_P_BattCurrentHys_A "" VALUE 0x20000014 __u32 0 NO_COMPU_METHOD 0 4294967295 /end CHARACTERISTIC
/begin CHARACTERISTIC SMon_P_BattRestCurrent_A "" VALUE 0x2000005C __u32 0 NO_COMPU_METHOD 0 4294967295 /end CHARACTERISTIC
/begin CHARACTERISTIC SMon_P_VoltageDivider "" VALUE 0x20000088 __u32 0 NO_COMPU_METHOD 0 4294967295 /end CHARACTERISTIC
/begin CHARACTERISTIC SMon_P_BattOcvCorrectionGain "" VALUE 0x20000034 __u32 0 NO_COMPU_METHOD 0 4294967295 /end CHARACTERISTIC
/begin CHARACTERISTIC SMon_P_UV_KL30 "" VALUE 0x200000E0 __u32 0 NO_COMPU_METHOD 0 4294967295 /end CHARACTERISTIC
/begin CHARACTERISTIC SMon_P_BattChargePathDeltaOn_V "" VALUE 0x20000010 __u32 0 NO_COMPU_METHOD 0 4294967295 /end CHARACTERISTIC
/begin CHARACTERISTIC SMon_P_BattSoHMin_pct "" VALUE 0x20000030 __u32 0 NO_COMPU_METHOD 0 4294967295 /end CHARACTERISTIC
/begin CHARACTERISTIC SMon_P_BattMinSoC_pct "" VALUE 0x200003EC __u32 0 NO_COMPU_METHOD 0 4294967295 /end CHARACTERISTIC
/begin CHARACTERISTIC SMon_P_VoltsAt25 "" VALUE 0x20000098 __u32 0 NO_COMPU_METHOD 0 4294967295 /end CHARACTERISTIC
/begin CHARACTERISTIC SMon_P_NTC_L1_TwoPointCalibration_ParamB "" VALUE 0x200000A8 __u32 0 NO_COMPU_METHOD 0 4294967295 /end CHARACTERISTIC
/begin CHARACTERISTIC SMon_P_BattCrankVolt_V "" VALUE 0x20000048 __u32 0 NO_COMPU_METHOD 0 4294967295 /end CHARACTERISTIC
/begin CHARACTERISTIC SMon_P_RetryCntS2bTestOn "" VALUE 0x2000010C __u32 0 NO_COMPU_METHOD 0 4294967295 /end CHARACTERISTIC
/begin CHARACTERISTIC SMon_P_LowVoltage "" VALUE 0x200000E4 __u32 0 NO_COMPU_METHOD 0 4294967295 /end CHARACTERISTIC
/begin CHARACTERISTIC SMon_P_RoomTemperature "" VALUE 0x20000090 __u32 0 NO_COMPU_METHOD 0 4294967295 /end CHARACTERISTIC
/begin CHARACTERISTIC SMon_P_BattRintMinStep_A "" VALUE 0x20000008 __u32 0 NO_COMPU_METHOD 0 4294967295 /end CHARACTERISTIC
/begin CHARACTERISTIC SMon_P_VFB_L1_TwoPointCalibration_ParamB "" VALUE 0x200000B0 __u32 0 NO_COMPU_METHOD 0 4294967295 /end CHARACTERISTIC
/begin CHARACTERISTIC SMon_P_BattChargeEfficiency "" VALUE 0x20000038 __u32 0 NO_COMPU_METHOD 0 4294967295 /end CHARACTERISTIC
/begin CHARACTERISTIC SMon_P_NTC_PullUp_ResistorVale "" VALUE 0x200000CC __u32 0 NO_COMPU_METHOD 0 4294967295 /end CHARACTERISTIC
/begin CHARACTERISTIC SMon_P_BattInitialSoC_pct "" VALUE 0x20000064 __u32 0 NO_COMPU_METHOD 0 4294967295 ENCODING UTF8 NUMBER 0 /end CHARACTERISTIC
/begin CHARACTERISTIC SMon_P_AlphaFilterExtChIsense "" VALUE 0x20000080 __u32 0 NO_COMPU_METHOD 0 4294967295 ENCODING UTF8 NUMBER 0 /end CHARACTERISTIC
/begin CHARACTERISTIC SMon_P_BattHybridBlendLowLoad "" VALUE 0x20000000 __u32 0 NO_COMPU_METHOD 0 4294967295 CALIBRATION_ACCESS CALIBRATION ENCODING UTF8 MAX_REFRESH 6 1 NUMBER 0 /end CHARACTERISTIC
/begin CHARACTERISTIC SMon_PeakCurrent "" VALUE 0x200004F0 __u32 0 NO_COMPU_METHOD 0 4294967295 ENCODING UTF8 NUMBER 0 /end CHARACTERISTIC
/begin CHARACTERISTIC SMon_ISenseL1_ExtChISense "" VALUE 0x200004EC __u32 0 NO_COMPU_METHOD 0 4294967295 ENCODING UTF8 NUMBER 0 /end CHARACTERISTIC
/begin CHARACTERISTIC SMon_ISenseL1_Float "" VALUE 0x200004F4 __u32 0 NO_COMPU_METHOD 0 4294967295 ENCODING UTF8 NUMBER 0 /end CHARACTERISTIC
/begin CHARACTERISTIC OS_XCP_U8_CPU_Load "" VALUE 0x20003CF4 __u8 0 NO_COMPU_METHOD 0 255 ENCODING UTF8 NUMBER 0 /end CHARACTERISTIC
/begin RECORD_LAYOUT __u8 FNC_VALUES 1 UBYTE COLUMN_DIR DIRECT /end RECORD_LAYOUT
/begin CHARACTERISTIC EcuM_WUPLine "" VALUE 0x2000031C __u8 0 NO_COMPU_METHOD 0 255 ENCODING UTF8 NUMBER 0 /end CHARACTERISTIC
/begin CHARACTERISTIC oscnt "" VALUE 0x20003CF0 __u32 0 NO_COMPU_METHOD 0 4294967295 ENCODING UTF8 NUMBER 0 /end CHARACTERISTIC
/end MODULE
/end PROJECT
